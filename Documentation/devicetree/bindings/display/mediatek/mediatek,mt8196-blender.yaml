## Documentation/devicetree/bindings/phy/mediatek,sgmii-phy.yaml
```yaml
# SPDX-License-Identifier: (GPL-2.0 OR BSD-2-Clause)
%YAML 1.2
---
$id: http://devicetree.org/schemas/phy/mediatek,sgmii-phy.yaml#
$schema: http://devicetree.org/meta-schemas/core.yaml#

title: MediaTek SGMII PHY

maintainers:
  - Arnaud Ferraris <arnaud.ferraris@collabora.com>

description: |
  The MediaTek SGMII PHY provides SerDes capability for interfacing
  Ethernet controllers with PHYs using the SGMII protocol.

properties:
  compatible:
    const: mediatek,mt8196-sgmii-phy

  reg:
    minItems: 2

  reg-names:
    items:
      - const: pcs
      - const: phy

  clocks:
    items:
      - description: Main SerDes clock
      - description: 325MHz SGMII reference clock

  clock-names:
    items:
      - const: bus
      - const: ref

  "#phy-cells":
    const: 0

  power-domains:
    maxItems: 1

required:
  - compatible
  - reg
  - reg-names
  - clocks
  - clock-names
  - "#phy-cells"

additionalProperties: false

examples:
  - |
    #include <dt-bindings/clock/mediatek,mt8196-clock.h>
    #include <dt-bindings/power/mediatek,mt8196-power.h>
    phy@138d0000 {
      compatible = "mediatek,mt8196-sgmii-phy";
      reg = <0x138d0000 0x1000>, <0x13910000 0x10000>;
      reg-names = "pcs", "phy";
      clocks = <&topckgen CLK_TOP_SGMII0_REG>,
               <&topckgen CLK_TOP_SGMII0_REF_325M>;
      clock-names = "bus", "ref";
      power-domains = <&spm MT8196_POWER_DOMAIN_HSGMII0>;
      #phy-cells = <0>;
    };
```
