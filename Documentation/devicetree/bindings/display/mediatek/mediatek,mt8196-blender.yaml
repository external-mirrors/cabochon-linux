## Documentation/devicetree/bindings/display/mediatek/mediatek,mt8196-blender.yaml
```yaml
# SPDX-License-Identifier: (GPL-2.0-only OR BSD-2-Clause)
%YAML 1.2
---
$id: http://devicetree.org/schemas/display/mediatek/mediatek,mt8196-blender.yaml#
$schema: http://devicetree.org/meta-schemas/core.yaml#

title: MediaTek Display Overlay Layer Blender

maintainers:
  - AngeloGioacchino Del Regno <angelogioacchino.delregno@collabora.com>

description:
  The MediaTek Display Overlay Layer Blender hardware is responsible
  for performing the alpha blending operation for overlapping layers
  from various sources.

properties:
  compatible:
    const: mediatek,mt8196-disp-blender

  reg:
    maxItems: 1

  clocks:
    maxItems: 1

  power-domains:
    maxItems: 1

  ports:
    $ref: /schemas/graph.yaml#/properties/ports

    properties:
      port@0:
        $ref: /schemas/graph.yaml#/properties/port

      port@1:
        $ref: /schemas/graph.yaml#/properties/port

    required:
      - port@0
      - port@1

  trigger-sources:
    maxItems: 1

required:
  - compatible
  - reg
  - clocks
  - clock-names
  - ports

additionalProperties: false

examples:
  - |
    #include <dt-bindings/interrupt-controller/arm-gic.h>
    #include <dt-bindings/clock/mediatek,mt8196-clock.h>
    #include <dt-bindings/power/mediatek,mt8196-power.h>

    blender@328e0000 {
        compatible = "mediatek,mt8196-disp-blender";
        reg = <0x328e0000 0x1000>;
        clocks = <&ovlsys0 CLK_OVL_BLENDER1>;
        power-domains = <&hpm_hwv MT8196_POWER_DOMAIN_OVL0_DORMANT>;
        trigger-sources = <&ovl0_mutex 11>;

        ports {
            #address-cells = <1>;
            #size-cells = <0>;

            port@0 {
                #address-cells = <1>;
                #size-cells = <0>;
                reg = <0>;

                endpoint@0 {
                    reg = <0>;
                    remote-endpoint = <&exdma0_2_out>;
                };
            };

            port@1 {
                #address-cells = <1>;
                #size-cells = <0>;
                reg = <1>;

                endpoint@0 {
                    reg = <0>;
                    remote-endpoint = <&exdma0_3_in>;
                };
            };
        };
    };

...
```

## Documentation/devicetree/bindings/display/mediatek/mediatek,mt8196-dvo.yaml
```yaml
# SPDX-License-Identifier: (GPL-2.0-only OR BSD-2-Clause)
%YAML 1.2
---
$id: http://devicetree.org/schemas/display/mediatek/mediatek,mt8196-dvo.yaml#
$schema: http://devicetree.org/meta-schemas/core.yaml#

title: MediaTek Digital Video Output (DVO) Controller

maintainers:
  - AngeloGioacchino Del Regno <angelogioacchino.delregno@collabora.com>

description:
  The MediaTek Digital Video Output (DVO) hardware provides 120-bits (4P) data,
  video timing and info data for the Embedded DisplayPort, hardware-abstracting
  the previous generation Display Port Interface (DPI/DP_INTF) blocks, other
  than providing new capabilities.
  This hardware block supports 1/2/4 pixels per iteration in both its input and
  output and provides 8/10-bit RGB, YUV422 and YUV444 data formats in output,
  other than supporting input/output video window cropping and padding.
  Digital Video Output also provides Panel Self Refresh (PSR) and Multi-SST
  Operation (MSO) features for eDP 1.3/1.4.

properties:
  compatible:
    enum:
      - mediatek,mt8189-dp-dvo
      - mediatek,mt8189-edp-dvo
      - mediatek,mt8196-edp-dvo

  reg:
    maxItems: 1

  interrupts:
    maxItems: 1

  clocks:
    items:
      - description: Pixel Clock
      - description: Engine Clock
      - description: DVO PLL

  clock-names:
    items:
      - const: pixel
      - const: engine
      - const: pll

  pinctrl-0: true
  pinctrl-1: true

  pinctrl-names:
    items:
      - const: default
      - const: sleep

  power-domains:
    maxItems: 1

  ports:
    $ref: /schemas/graph.yaml#/properties/ports

    properties:
      port@0:
        $ref: /schemas/graph.yaml#/properties/port
        description: Digital Video Output's input port

      port@1:
        $ref: /schemas/graph.yaml#/properties/port
        description: DVO output to an HDMI, LVDS or DisplayPort encoder input

    required:
      - port@0
      - port@1

  resets:
    maxItems: 1

  reset-names:
    items:
      - const: dvo

  trigger-sources:
    maxItems: 1

required:
  - compatible
  - reg
  - interrupts
  - clocks
  - clock-names
  - ports

additionalProperties: false

examples:
  - |
    #include <dt-bindings/interrupt-controller/arm-gic.h>
    #include <dt-bindings/clock/mediatek,mt8196-clock.h>
    #include <dt-bindings/power/mediatek,mt8196-power.h>

    dvo@324c0000 {
        compatible = "mediatek,mt8196-edp-dvo";
        reg = <0x324c0000 0x1000>;
        interrupts = <GIC_SPI 461 IRQ_TYPE_LEVEL_HIGH>;
        clocks = <&dispsys1 CLK_MM1_DISP_DVO0>,
                 <&dispsys1 CLK_MM1_MOD6>,
                 <&apmixedsys_gp2 CLK_APMIXED2_TVDPLL3>;
        clock-names = "pixel", "engine", "pll";
        power-domains = <&hpm_hwv MT8196_POWER_DOMAIN_DIS0_DORMANT>;
        pinctrl-names = "default", "sleep";
        pinctrl-0 = <&dvo_pins_default>;
        pinctrl-1 = <&dvo_pin_sleep>;
        trigger-sources = <&disp1_mutex 29>;

        ports {
            #address-cells = <1>;
            #size-cells = <0>;

            port@0 {
                #address-cells = <1>;
                #size-cells = <0>;
                reg = <0>;

                endpoint@0 {
                    reg = <0>;
                    remote-endpoint = <&directlink_output>;
                };
            };

            port@1 {
                #address-cells = <1>;
                #size-cells = <0>;
                reg = <1>;

                endpoint@0 {
                    reg = <0>;
                    remote-endpoint = <&displayport_input>;
                };
            };
        };
    };

...
```

## Documentation/devicetree/bindings/display/mediatek/mediatek,mt8196-exdma.yaml
```yaml
# SPDX-License-Identifier: (GPL-2.0-only OR BSD-2-Clause)
%YAML 1.2
---
$id: http://devicetree.org/schemas/display/mediatek/mediatek,mt8196-exdma.yaml#
$schema: http://devicetree.org/meta-schemas/core.yaml#

title: MediaTek Display Overlay extended DMA (exDMA) Engine

maintainers:
  - AngeloGioacchino Del Regno <angelogioacchino.delregno@collabora.com>

description:
  The MediaTek Display Overlay extended DMA (exDMA) Engine hardware is used
  to configure the Display Controller to read the data from DRAM to perform
  layer overlaying.
  This hardware also includes color conversion functions to output pixels
  processed into a consistent color domain.

properties:
  compatible:
    const: mediatek,mt8196-disp-exdma

  reg:
    maxItems: 1

  "#dma-cells":
    maxItems: 1

  clocks:
    maxItems: 1

  power-domains:
    maxItems: 1

  ports:
    $ref: /schemas/graph.yaml#/properties/ports

    properties:
      port@0:
        $ref: /schemas/graph.yaml#/properties/port

      port@1:
        $ref: /schemas/graph.yaml#/properties/port

    required:
      - port@0
      - port@1

  trigger-sources:
    maxItems: 1

required:
  - compatible
  - reg
  - "#dma-cells"
  - clocks
  - clock-names
  - ports

additionalProperties: false

examples:
  - |
    #include <dt-bindings/interrupt-controller/arm-gic.h>
    #include <dt-bindings/clock/mediatek,mt8196-clock.h>
    #include <dt-bindings/power/mediatek,mt8196-power.h>

    dma-controller@32850000 {
        compatible = "mediatek,mt8196-disp-exdma";
        reg = <0x32850000 0x1000>;
        #dma-cells = <1>;
        clocks = <&ovlsys0 CLK_OVL_EXDMA2>;
        power-domains = <&hpm_hwv MT8196_POWER_DOMAIN_OVL0_DORMANT>;
        trigger-sources = <&ovl0_mutex 2>;

        ports {
            #address-cells = <1>;
            #size-cells = <0>;

            port@0 {
                #address-cells = <1>;
                #size-cells = <0>;
                reg = <0>;

                endpoint@0 {
                    reg = <0>;
                    remote-endpoint = <&ovl0_resizer0_out>;
                };
            };

            port@1 {
                #address-cells = <1>;
                #size-cells = <0>;
                reg = <1>;

                endpoint@0 {
                    reg = <0>;
                    remote-endpoint = <&blender0_1_in>;
                };
            };
        };
    };

...
```

## Documentation/devicetree/bindings/display/mediatek/mediatek,mt8196-outproc.yaml
```yaml
# SPDX-License-Identifier: (GPL-2.0-only OR BSD-2-Clause)
%YAML 1.2
---
$id: http://devicetree.org/schemas/display/mediatek/mediatek,mt8196-outproc.yaml#
$schema: http://devicetree.org/meta-schemas/core.yaml#

title: MediaTek Display Overlay Output Processor

maintainers:
  - AngeloGioacchino Del Regno <angelogioacchino.delregno@collabora.com>

description:
  The MediaTek Display Overlay Output Processor hardware handles the
  post-stage of pixel processing in the layer overlaying process and
  is also capable of performing gamma correction, ensuring that the
  per-pixel values are within the expected luma range.
  If an instance of this hardware is configured as last stage, it is
  also capable of generating VBlank (Frame Done) events which can be
  then dispatched either via an interrupt (to the CPU) or through a
  Global Command Engine (GCE) Event, internally sent to programmable
  Command Queue (CMDQ) Engine(s) for offloading purposes.

properties:
  compatible:
    const: mediatek,mt8196-disp-outproc

  reg:
    maxItems: 1

  clocks:
    maxItems: 1

  interrupts:
    description: Optional VBlank event interrupt
    maxItems: 1

  power-domains:
    maxItems: 1

  ports:
    $ref: /schemas/graph.yaml#/properties/ports

    properties:
      port@0:
        $ref: /schemas/graph.yaml#/properties/port

      port@1:
        $ref: /schemas/graph.yaml#/properties/port

    required:
      - port@0
      - port@1

  trigger-sources:
    maxItems: 1

required:
  - compatible
  - reg
  - clocks
  - clock-names
  - ports

additionalProperties: false

examples:
  - |
    #include <dt-bindings/interrupt-controller/arm-gic.h>
    #include <dt-bindings/clock/mediatek,mt8196-clock.h>
    #include <dt-bindings/power/mediatek,mt8196-power.h>

    outproc@32970000 {
        compatible = "mediatek,mt8196-disp-outproc";
        reg = <0x32970000 0x1000>;
        clocks = <&ovlsys0 CLK_OVL_OUTPROC0>;
        power-domains = <&hpm_hwv MT8196_POWER_DOMAIN_OVL0_DORMANT>;
        trigger-sources = <&ovl0_mutex 20>;

        ports {
            #address-cells = <1>;
            #size-cells = <0>;

            port@0 {
                #address-cells = <1>;
                #size-cells = <0>;
                reg = <0>;

                endpoint@0 {
                    reg = <0>;
                    remote-endpoint = <&blender0_8_out>;
                };
            };

            port@1 {
                #address-cells = <1>;
                #size-cells = <0>;
                reg = <1>;

                endpoint@0 {
                    reg = <0>;
                    remote-endpoint = <&ovl0_directlink_out_relay6>;
                };
            };
        };
    };

...
```

## Documentation/devicetree/bindings/display/mediatek/mediatek,mt8196-rsz.yaml
```yaml
# SPDX-License-Identifier: (GPL-2.0-only OR BSD-2-Clause)
%YAML 1.2
---
$id: http://devicetree.org/schemas/display/mediatek/mediatek,mt8196-rsz.yaml#
$schema: http://devicetree.org/meta-schemas/core.yaml#

title: MediaTek Display Image Resizer (RSZ)

maintainers:
  - AngeloGioacchino Del Regno <angelogioacchino.delregno@collabora.com>

description:
  The MediaTek Display Image Resizer (RSZ) is a high fidelity scaler block,
  with filters and signal enhancers, responsible for performing downscaling
  or upscaling of a frame.

properties:
  compatible:
    const: mediatek,mt8196-disp-rsz

  reg:
    maxItems: 1

  clocks:
    maxItems: 1

  power-domains:
    maxItems: 1

  ports:
    $ref: /schemas/graph.yaml#/properties/ports

    properties:
      port@0:
        $ref: /schemas/graph.yaml#/properties/port

      port@1:
        $ref: /schemas/graph.yaml#/properties/port

    required:
      - port@0
      - port@1

  trigger-sources:
    maxItems: 1

required:
  - compatible
  - reg
  - clocks
  - clock-names
  - ports

additionalProperties: false

examples:
  - |
    #include <dt-bindings/interrupt-controller/arm-gic.h>
    #include <dt-bindings/clock/mediatek,mt8196-clock.h>
    #include <dt-bindings/power/mediatek,mt8196-power.h>

    scaler@329d0000 {
        compatible = "mediatek,mt8196-disp-rsz";
        reg = <0x329d0000 0x1000>;
        clocks = <&ovlsys0 CLK_OVL_MDP_RSZ0>;
        power-domains = <&hpm_hwv MT8196_POWER_DOMAIN_OVL0_DORMANT>;
        trigger-sources = <&ovl0_mutex 26>;

        ports {
            #address-cells = <1>;
            #size-cells = <0>;

            port@0 {
                #address-cells = <1>;
                #size-cells = <0>;
                reg = <0>;

                endpoint@0 {
                    reg = <0>;
                    remote-endpoint = <&ep_main_out>;
                };
            };

            port@1 {
                #address-cells = <1>;
                #size-cells = <0>;
                reg = <1>;

                endpoint@0 {
                    reg = <0>;
                    remote-endpoint = <&exdma0_2_in>;
                };
            };
        };
    };

...
```

## Documentation/devicetree/bindings/interrupt-controller/mediatek,mt8196-vdisp-irq.yaml
```yaml
# SPDX-License-Identifier: (GPL-2.0-only OR BSD-2-Clause)
%YAML 1.2
---
$id: http://devicetree.org/schemas/interrupt-controller/mediatek,mt8196-vdisp-irq.yaml#
$schema: http://devicetree.org/meta-schemas/core.yaml#

title: MediaTek VDisp Interrupt Crossbar

maintainers:
  - AngeloGioacchino Del Regno <angelogioacchino.delregno@collabora.com>

description:
  Some MediaTek SoCs have a large number of hardware interrupts in various of
  the internal subsystems. One of those is the Multimedia Subsystem, which has
  more interrupts than the available lines in the main interrupt controller.
  Luckily though, not exactly all of the Multimedia-related interrupts would
  be needed for correct operation, as such a requirement is dependant on the
  SoC, board and actual software implementation, and that's why this Crossbar
  does exist in the first place.
  The VDisp Interrupt Crossbar, located in the Multimedia block of the SoC, is
  therefore in charge of muxing a selection of hardware interrupts to the main
  interrupt controller.

properties:
  compatible:
    const: mediatek,mt8196-vdisp-irq

  reg:
    maxItems: 1

  interrupt-controller: true

  '#interrupt-cells':
    const: 2

required:
  - compatible
  - reg
  - interrupt-controller
  - '#interrupt-cells'

additionalProperties: false

examples:
  - |
    interrupt-controller@3e800000 {
        compatible = "mediatek,mt8196-vdisp-irq";
        reg = <0x3e800000 0x100>;
        interrupt-parent = <&gic>;
        interrupt-controller;
        #interrupt-cells = <2>;
    };
```
